## build-wl/Kconfig/soc/Kconfig.soc
```kconfig
# Load SoC Kconfig descriptions.
osource "/home/starlark/github/zephyr/soc/xlnx/zynqmp/Kconfig.soc"
osource "/home/starlark/github/zephyr/soc/xlnx/zynq7000/Kconfig.soc"
osource "/home/starlark/github/zephyr/soc/xen/Kconfig.soc"
osource "/home/starlark/github/zephyr/soc/ti/simplelink/Kconfig.soc"
osource "/home/starlark/github/zephyr/soc/ti/lm3s6965/Kconfig.soc"
osource "/home/starlark/github/zephyr/soc/ti/k3/Kconfig.soc"
osource "/home/starlark/github/zephyr/soc/telink/tlsr/Kconfig.soc"
osource "/home/starlark/github/zephyr/soc/starfive/jh71xx/Kconfig.soc"
osource "/home/starlark/github/zephyr/soc/st/stm32/Kconfig.soc"
osource "/home/starlark/github/zephyr/soc/snps/qemu_arc/Kconfig.soc"
osource "/home/starlark/github/zephyr/soc/snps/nsim/arc_v/Kconfig.soc"
osource "/home/starlark/github/zephyr/soc/snps/nsim/arc_classic/Kconfig.soc"
osource "/home/starlark/github/zephyr/soc/snps/hsdk4xd/Kconfig.soc"
osource "/home/starlark/github/zephyr/soc/snps/hsdk/Kconfig.soc"
osource "/home/starlark/github/zephyr/soc/snps/emsk/Kconfig.soc"
osource "/home/starlark/github/zephyr/soc/snps/emsdp/Kconfig.soc"
osource "/home/starlark/github/zephyr/soc/snps/arc_iot/Kconfig.soc"
osource "/home/starlark/github/zephyr/soc/silabs/Kconfig.soc"
osource "/home/starlark/github/zephyr/soc/sifive/sifive_freedom/Kconfig.soc"
osource "/home/starlark/github/zephyr/soc/rockchip/Kconfig.soc"
osource "/home/starlark/github/zephyr/soc/renode/riscv_virtual/Kconfig.soc"
osource "/home/starlark/github/zephyr/soc/renesas/smartbond/Kconfig.soc"
osource "/home/starlark/github/zephyr/soc/renesas/rzt2m/Kconfig.soc"
osource "/home/starlark/github/zephyr/soc/renesas/rcar/Kconfig.soc"
osource "/home/starlark/github/zephyr/soc/renesas/ra/Kconfig.soc"
osource "/home/starlark/github/zephyr/soc/raspberrypi/Kconfig.soc"
osource "/home/starlark/github/zephyr/soc/quicklogic/eos_s3/Kconfig.soc"
osource "/home/starlark/github/zephyr/soc/qemu/virt_riscv/Kconfig.soc"
osource "/home/starlark/github/zephyr/soc/qemu/malta/Kconfig.soc"
osource "/home/starlark/github/zephyr/soc/openisa/rv32m1/Kconfig.soc"
osource "/home/starlark/github/zephyr/soc/nxp/s32/Kconfig.soc"
osource "/home/starlark/github/zephyr/soc/nxp/rw/Kconfig.soc"
osource "/home/starlark/github/zephyr/soc/nxp/mcx/Kconfig.soc"
osource "/home/starlark/github/zephyr/soc/nxp/lpc/Kconfig.soc"
osource "/home/starlark/github/zephyr/soc/nxp/layerscape/Kconfig.soc"
osource "/home/starlark/github/zephyr/soc/nxp/kinetis/Kconfig.soc"
osource "/home/starlark/github/zephyr/soc/nxp/imxrt/Kconfig.soc"
osource "/home/starlark/github/zephyr/soc/nxp/imx/Kconfig.soc"
osource "/home/starlark/github/zephyr/soc/nuvoton/numicro/Kconfig.soc"
osource "/home/starlark/github/zephyr/soc/nuvoton/numaker/Kconfig.soc"
osource "/home/starlark/github/zephyr/soc/nuvoton/npcx/Kconfig.soc"
osource "/home/starlark/github/zephyr/soc/nordic/Kconfig.soc"
osource "/home/starlark/github/zephyr/soc/neorv32/Kconfig.soc"
osource "/home/starlark/github/zephyr/soc/native/inf_clock/Kconfig.soc"
osource "/home/starlark/github/zephyr/soc/microchip/miv/Kconfig.soc"
osource "/home/starlark/github/zephyr/soc/microchip/mec/Kconfig.soc"
osource "/home/starlark/github/zephyr/soc/mediatek/mtk_adsp/Kconfig.soc"
osource "/home/starlark/github/zephyr/soc/lowrisc/opentitan/Kconfig.soc"
osource "/home/starlark/github/zephyr/soc/litex/litex_vexriscv/Kconfig.soc"
osource "/home/starlark/github/zephyr/soc/ite/ec/Kconfig.soc"
osource "/home/starlark/github/zephyr/soc/intel/raptor_lake/Kconfig.soc"
osource "/home/starlark/github/zephyr/soc/intel/lakemont/Kconfig.soc"
osource "/home/starlark/github/zephyr/soc/intel/intel_socfpga_std/Kconfig.soc"
osource "/home/starlark/github/zephyr/soc/intel/intel_socfpga/Kconfig.soc"
osource "/home/starlark/github/zephyr/soc/intel/intel_niosv/Kconfig.soc"
osource "/home/starlark/github/zephyr/soc/intel/intel_ish/Kconfig.soc"
osource "/home/starlark/github/zephyr/soc/intel/intel_adsp/Kconfig.soc"
osource "/home/starlark/github/zephyr/soc/intel/elkhart_lake/Kconfig.soc"
osource "/home/starlark/github/zephyr/soc/intel/atom/Kconfig.soc"
osource "/home/starlark/github/zephyr/soc/intel/apollo_lake/Kconfig.soc"
osource "/home/starlark/github/zephyr/soc/intel/alder_lake/Kconfig.soc"
osource "/home/starlark/github/zephyr/soc/infineon/cat3/Kconfig.soc"
osource "/home/starlark/github/zephyr/soc/infineon/cat1b/Kconfig.soc"
osource "/home/starlark/github/zephyr/soc/infineon/cat1a/Kconfig.soc"
osource "/home/starlark/github/zephyr/soc/gd/gd32/Kconfig.soc"
osource "/home/starlark/github/zephyr/soc/gaisler/leon3/Kconfig.soc"
osource "/home/starlark/github/zephyr/soc/gaisler/gr716a/Kconfig.soc"
osource "/home/starlark/github/zephyr/soc/espressif/Kconfig.soc"
osource "/home/starlark/github/zephyr/soc/ene/kb1200/Kconfig.soc"
osource "/home/starlark/github/zephyr/soc/efinix/sapphire/Kconfig.soc"
osource "/home/starlark/github/zephyr/soc/cdns/xtensa_sample_controller/Kconfig.soc"
osource "/home/starlark/github/zephyr/soc/cdns/dc233c/Kconfig.soc"
osource "/home/starlark/github/zephyr/soc/brcm/bcmvk/Kconfig.soc"
osource "/home/starlark/github/zephyr/soc/brcm/bcm2712/Kconfig.soc"
osource "/home/starlark/github/zephyr/soc/brcm/bcm2711/Kconfig.soc"
osource "/home/starlark/github/zephyr/soc/atmel/sam0/Kconfig.soc"
osource "/home/starlark/github/zephyr/soc/atmel/sam/Kconfig.soc"
osource "/home/starlark/github/zephyr/soc/aspeed/Kconfig.soc"
osource "/home/starlark/github/zephyr/soc/arm/Kconfig.soc"
osource "/home/starlark/github/zephyr/soc/arm/beetle/Kconfig.soc"
osource "/home/starlark/github/zephyr/soc/andestech/Kconfig.soc"
osource "/home/starlark/github/zephyr/soc/ambiq/Kconfig.soc"
osource "/home/starlark/github/zephyr/soc/altr/zephyr_nios2f/Kconfig.soc"
osource "/home/starlark/github/zephyr/soc/altr/qemu_nios2/Kconfig.soc"
osource "/home/starlark/github/zephyr/soc/adi/max32/Kconfig.soc"
```

## build-wl/Kconfig/soc/Kconfig.sysbuild
```kconfig
# Load SoC sysbuild Kconfig descriptions.
osource "/home/starlark/github/zephyr/soc/xlnx/zynqmp/Kconfig.sysbuild"
osource "/home/starlark/github/zephyr/soc/xlnx/zynq7000/Kconfig.sysbuild"
osource "/home/starlark/github/zephyr/soc/xen/Kconfig.sysbuild"
osource "/home/starlark/github/zephyr/soc/ti/simplelink/Kconfig.sysbuild"
osource "/home/starlark/github/zephyr/soc/ti/lm3s6965/Kconfig.sysbuild"
osource "/home/starlark/github/zephyr/soc/ti/k3/Kconfig.sysbuild"
osource "/home/starlark/github/zephyr/soc/telink/tlsr/Kconfig.sysbuild"
osource "/home/starlark/github/zephyr/soc/starfive/jh71xx/Kconfig.sysbuild"
osource "/home/starlark/github/zephyr/soc/st/stm32/Kconfig.sysbuild"
osource "/home/starlark/github/zephyr/soc/snps/qemu_arc/Kconfig.sysbuild"
osource "/home/starlark/github/zephyr/soc/snps/nsim/arc_v/Kconfig.sysbuild"
osource "/home/starlark/github/zephyr/soc/snps/nsim/arc_classic/Kconfig.sysbuild"
osource "/home/starlark/github/zephyr/soc/snps/hsdk4xd/Kconfig.sysbuild"
osource "/home/starlark/github/zephyr/soc/snps/hsdk/Kconfig.sysbuild"
osource "/home/starlark/github/zephyr/soc/snps/emsk/Kconfig.sysbuild"
osource "/home/starlark/github/zephyr/soc/snps/emsdp/Kconfig.sysbuild"
osource "/home/starlark/github/zephyr/soc/snps/arc_iot/Kconfig.sysbuild"
osource "/home/starlark/github/zephyr/soc/silabs/Kconfig.sysbuild"
osource "/home/starlark/github/zephyr/soc/sifive/sifive_freedom/Kconfig.sysbuild"
osource "/home/starlark/github/zephyr/soc/rockchip/Kconfig.sysbuild"
osource "/home/starlark/github/zephyr/soc/renode/riscv_virtual/Kconfig.sysbuild"
osource "/home/starlark/github/zephyr/soc/renesas/smartbond/Kconfig.sysbuild"
osource "/home/starlark/github/zephyr/soc/renesas/rzt2m/Kconfig.sysbuild"
osource "/home/starlark/github/zephyr/soc/renesas/rcar/Kconfig.sysbuild"
osource "/home/starlark/github/zephyr/soc/renesas/ra/Kconfig.sysbuild"
osource "/home/starlark/github/zephyr/soc/raspberrypi/Kconfig.sysbuild"
osource "/home/starlark/github/zephyr/soc/quicklogic/eos_s3/Kconfig.sysbuild"
osource "/home/starlark/github/zephyr/soc/qemu/virt_riscv/Kconfig.sysbuild"
osource "/home/starlark/github/zephyr/soc/qemu/malta/Kconfig.sysbuild"
osource "/home/starlark/github/zephyr/soc/openisa/rv32m1/Kconfig.sysbuild"
osource "/home/starlark/github/zephyr/soc/nxp/s32/Kconfig.sysbuild"
osource "/home/starlark/github/zephyr/soc/nxp/rw/Kconfig.sysbuild"
osource "/home/starlark/github/zephyr/soc/nxp/mcx/Kconfig.sysbuild"
osource "/home/starlark/github/zephyr/soc/nxp/lpc/Kconfig.sysbuild"
osource "/home/starlark/github/zephyr/soc/nxp/layerscape/Kconfig.sysbuild"
osource "/home/starlark/github/zephyr/soc/nxp/kinetis/Kconfig.sysbuild"
osource "/home/starlark/github/zephyr/soc/nxp/imxrt/Kconfig.sysbuild"
osource "/home/starlark/github/zephyr/soc/nxp/imx/Kconfig.sysbuild"
osource "/home/starlark/github/zephyr/soc/nuvoton/numicro/Kconfig.sysbuild"
osource "/home/starlark/github/zephyr/soc/nuvoton/numaker/Kconfig.sysbuild"
osource "/home/starlark/github/zephyr/soc/nuvoton/npcx/Kconfig.sysbuild"
osource "/home/starlark/github/zephyr/soc/nordic/Kconfig.sysbuild"
osource "/home/starlark/github/zephyr/soc/neorv32/Kconfig.sysbuild"
osource "/home/starlark/github/zephyr/soc/native/inf_clock/Kconfig.sysbuild"
osource "/home/starlark/github/zephyr/soc/microchip/miv/Kconfig.sysbuild"
osource "/home/starlark/github/zephyr/soc/microchip/mec/Kconfig.sysbuild"
osource "/home/starlark/github/zephyr/soc/mediatek/mtk_adsp/Kconfig.sysbuild"
osource "/home/starlark/github/zephyr/soc/lowrisc/opentitan/Kconfig.sysbuild"
osource "/home/starlark/github/zephyr/soc/litex/litex_vexriscv/Kconfig.sysbuild"
osource "/home/starlark/github/zephyr/soc/ite/ec/Kconfig.sysbuild"
osource "/home/starlark/github/zephyr/soc/intel/raptor_lake/Kconfig.sysbuild"
osource "/home/starlark/github/zephyr/soc/intel/lakemont/Kconfig.sysbuild"
osource "/home/starlark/github/zephyr/soc/intel/intel_socfpga_std/Kconfig.sysbuild"
osource "/home/starlark/github/zephyr/soc/intel/intel_socfpga/Kconfig.sysbuild"
osource "/home/starlark/github/zephyr/soc/intel/intel_niosv/Kconfig.sysbuild"
osource "/home/starlark/github/zephyr/soc/intel/intel_ish/Kconfig.sysbuild"
osource "/home/starlark/github/zephyr/soc/intel/intel_adsp/Kconfig.sysbuild"
osource "/home/starlark/github/zephyr/soc/intel/elkhart_lake/Kconfig.sysbuild"
osource "/home/starlark/github/zephyr/soc/intel/atom/Kconfig.sysbuild"
osource "/home/starlark/github/zephyr/soc/intel/apollo_lake/Kconfig.sysbuild"
osource "/home/starlark/github/zephyr/soc/intel/alder_lake/Kconfig.sysbuild"
osource "/home/starlark/github/zephyr/soc/infineon/cat3/Kconfig.sysbuild"
osource "/home/starlark/github/zephyr/soc/infineon/cat1b/Kconfig.sysbuild"
osource "/home/starlark/github/zephyr/soc/infineon/cat1a/Kconfig.sysbuild"
osource "/home/starlark/github/zephyr/soc/gd/gd32/Kconfig.sysbuild"
osource "/home/starlark/github/zephyr/soc/gaisler/leon3/Kconfig.sysbuild"
osource "/home/starlark/github/zephyr/soc/gaisler/gr716a/Kconfig.sysbuild"
osource "/home/starlark/github/zephyr/soc/espressif/Kconfig.sysbuild"
osource "/home/starlark/github/zephyr/soc/ene/kb1200/Kconfig.sysbuild"
osource "/home/starlark/github/zephyr/soc/efinix/sapphire/Kconfig.sysbuild"
osource "/home/starlark/github/zephyr/soc/cdns/xtensa_sample_controller/Kconfig.sysbuild"
osource "/home/starlark/github/zephyr/soc/cdns/dc233c/Kconfig.sysbuild"
osource "/home/starlark/github/zephyr/soc/brcm/bcmvk/Kconfig.sysbuild"
osource "/home/starlark/github/zephyr/soc/brcm/bcm2712/Kconfig.sysbuild"
osource "/home/starlark/github/zephyr/soc/brcm/bcm2711/Kconfig.sysbuild"
osource "/home/starlark/github/zephyr/soc/atmel/sam0/Kconfig.sysbuild"
osource "/home/starlark/github/zephyr/soc/atmel/sam/Kconfig.sysbuild"
osource "/home/starlark/github/zephyr/soc/aspeed/Kconfig.sysbuild"
osource "/home/starlark/github/zephyr/soc/arm/Kconfig.sysbuild"
osource "/home/starlark/github/zephyr/soc/arm/beetle/Kconfig.sysbuild"
osource "/home/starlark/github/zephyr/soc/andestech/Kconfig.sysbuild"
osource "/home/starlark/github/zephyr/soc/ambiq/Kconfig.sysbuild"
osource "/home/starlark/github/zephyr/soc/altr/zephyr_nios2f/Kconfig.sysbuild"
osource "/home/starlark/github/zephyr/soc/altr/qemu_nios2/Kconfig.sysbuild"
osource "/home/starlark/github/zephyr/soc/adi/max32/Kconfig.sysbuild"
```
