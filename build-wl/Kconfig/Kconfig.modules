## build-wl/Kconfig/Kconfig.modules
```kconfig
menu "cmsis (/home/starlark/github/modules/hal/cmsis)"
osource "$(ZEPHYR_CMSIS_KCONFIG)"
config ZEPHYR_CMSIS_MODULE
	bool
	default y
endmenu
menu "hal_rpi_pico (/home/starlark/github/modules/hal/rpi_pico)"
osource "$(ZEPHYR_HAL_RPI_PICO_KCONFIG)"
config ZEPHYR_HAL_RPI_PICO_MODULE
	bool
	default y
endmenu
```

## build-wl/Kconfig/Kconfig.sysbuild.modules
```kconfig
config ZEPHYR_CMSIS_MODULE
   bool
   default y
config ZEPHYR_HAL_RPI_PICO_MODULE
   bool
   default y
```

## build-wl/Kconfig/arch/Kconfig
```kconfig
# Load arch Kconfig descriptions.
osource "/home/starlark/github/zephyr/arch/x86/Kconfig"
osource "/home/starlark/github/zephyr/arch/xtensa/Kconfig"
osource "/home/starlark/github/zephyr/arch/sparc/Kconfig"
osource "/home/starlark/github/zephyr/arch/riscv/Kconfig"
osource "/home/starlark/github/zephyr/arch/posix/Kconfig"
osource "/home/starlark/github/zephyr/arch/nios2/Kconfig"
osource "/home/starlark/github/zephyr/arch/mips/Kconfig"
osource "/home/starlark/github/zephyr/arch/arm64/Kconfig"
osource "/home/starlark/github/zephyr/arch/arm/Kconfig"
osource "/home/starlark/github/zephyr/arch/arc/Kconfig"
```

## build-wl/Kconfig/soc/Kconfig
```kconfig
# Load Zephyr SoC Kconfig descriptions.
osource "/home/starlark/github/zephyr/soc/xlnx/zynqmp/Kconfig"
osource "/home/starlark/github/zephyr/soc/xlnx/zynq7000/Kconfig"
osource "/home/starlark/github/zephyr/soc/xen/Kconfig"
osource "/home/starlark/github/zephyr/soc/ti/simplelink/Kconfig"
osource "/home/starlark/github/zephyr/soc/ti/lm3s6965/Kconfig"
osource "/home/starlark/github/zephyr/soc/ti/k3/Kconfig"
osource "/home/starlark/github/zephyr/soc/telink/tlsr/Kconfig"
osource "/home/starlark/github/zephyr/soc/starfive/jh71xx/Kconfig"
osource "/home/starlark/github/zephyr/soc/st/stm32/Kconfig"
osource "/home/starlark/github/zephyr/soc/snps/qemu_arc/Kconfig"
osource "/home/starlark/github/zephyr/soc/snps/nsim/arc_v/Kconfig"
osource "/home/starlark/github/zephyr/soc/snps/nsim/arc_classic/Kconfig"
osource "/home/starlark/github/zephyr/soc/snps/hsdk4xd/Kconfig"
osource "/home/starlark/github/zephyr/soc/snps/hsdk/Kconfig"
osource "/home/starlark/github/zephyr/soc/snps/emsk/Kconfig"
osource "/home/starlark/github/zephyr/soc/snps/emsdp/Kconfig"
osource "/home/starlark/github/zephyr/soc/snps/arc_iot/Kconfig"
osource "/home/starlark/github/zephyr/soc/silabs/Kconfig"
osource "/home/starlark/github/zephyr/soc/sifive/sifive_freedom/Kconfig"
osource "/home/starlark/github/zephyr/soc/rockchip/Kconfig"
osource "/home/starlark/github/zephyr/soc/renode/riscv_virtual/Kconfig"
osource "/home/starlark/github/zephyr/soc/renesas/smartbond/Kconfig"
osource "/home/starlark/github/zephyr/soc/renesas/rzt2m/Kconfig"
osource "/home/starlark/github/zephyr/soc/renesas/rcar/Kconfig"
osource "/home/starlark/github/zephyr/soc/renesas/ra/Kconfig"
osource "/home/starlark/github/zephyr/soc/raspberrypi/Kconfig"
osource "/home/starlark/github/zephyr/soc/quicklogic/eos_s3/Kconfig"
osource "/home/starlark/github/zephyr/soc/qemu/virt_riscv/Kconfig"
osource "/home/starlark/github/zephyr/soc/qemu/malta/Kconfig"
osource "/home/starlark/github/zephyr/soc/openisa/rv32m1/Kconfig"
osource "/home/starlark/github/zephyr/soc/nxp/s32/Kconfig"
osource "/home/starlark/github/zephyr/soc/nxp/rw/Kconfig"
osource "/home/starlark/github/zephyr/soc/nxp/mcx/Kconfig"
osource "/home/starlark/github/zephyr/soc/nxp/lpc/Kconfig"
osource "/home/starlark/github/zephyr/soc/nxp/layerscape/Kconfig"
osource "/home/starlark/github/zephyr/soc/nxp/kinetis/Kconfig"
osource "/home/starlark/github/zephyr/soc/nxp/imxrt/Kconfig"
osource "/home/starlark/github/zephyr/soc/nxp/imx/Kconfig"
osource "/home/starlark/github/zephyr/soc/nuvoton/numicro/Kconfig"
osource "/home/starlark/github/zephyr/soc/nuvoton/numaker/Kconfig"
osource "/home/starlark/github/zephyr/soc/nuvoton/npcx/Kconfig"
osource "/home/starlark/github/zephyr/soc/nordic/Kconfig"
osource "/home/starlark/github/zephyr/soc/neorv32/Kconfig"
osource "/home/starlark/github/zephyr/soc/native/inf_clock/Kconfig"
osource "/home/starlark/github/zephyr/soc/microchip/miv/Kconfig"
osource "/home/starlark/github/zephyr/soc/microchip/mec/Kconfig"
osource "/home/starlark/github/zephyr/soc/mediatek/mtk_adsp/Kconfig"
osource "/home/starlark/github/zephyr/soc/lowrisc/opentitan/Kconfig"
osource "/home/starlark/github/zephyr/soc/litex/litex_vexriscv/Kconfig"
osource "/home/starlark/github/zephyr/soc/ite/ec/Kconfig"
osource "/home/starlark/github/zephyr/soc/intel/raptor_lake/Kconfig"
osource "/home/starlark/github/zephyr/soc/intel/lakemont/Kconfig"
osource "/home/starlark/github/zephyr/soc/intel/intel_socfpga_std/Kconfig"
osource "/home/starlark/github/zephyr/soc/intel/intel_socfpga/Kconfig"
osource "/home/starlark/github/zephyr/soc/intel/intel_niosv/Kconfig"
osource "/home/starlark/github/zephyr/soc/intel/intel_ish/Kconfig"
osource "/home/starlark/github/zephyr/soc/intel/intel_adsp/Kconfig"
osource "/home/starlark/github/zephyr/soc/intel/elkhart_lake/Kconfig"
osource "/home/starlark/github/zephyr/soc/intel/atom/Kconfig"
osource "/home/starlark/github/zephyr/soc/intel/apollo_lake/Kconfig"
osource "/home/starlark/github/zephyr/soc/intel/alder_lake/Kconfig"
osource "/home/starlark/github/zephyr/soc/infineon/cat3/Kconfig"
osource "/home/starlark/github/zephyr/soc/infineon/cat1b/Kconfig"
osource "/home/starlark/github/zephyr/soc/infineon/cat1a/Kconfig"
osource "/home/starlark/github/zephyr/soc/gd/gd32/Kconfig"
osource "/home/starlark/github/zephyr/soc/gaisler/leon3/Kconfig"
osource "/home/starlark/github/zephyr/soc/gaisler/gr716a/Kconfig"
osource "/home/starlark/github/zephyr/soc/espressif/Kconfig"
osource "/home/starlark/github/zephyr/soc/ene/kb1200/Kconfig"
osource "/home/starlark/github/zephyr/soc/efinix/sapphire/Kconfig"
osource "/home/starlark/github/zephyr/soc/cdns/xtensa_sample_controller/Kconfig"
osource "/home/starlark/github/zephyr/soc/cdns/dc233c/Kconfig"
osource "/home/starlark/github/zephyr/soc/brcm/bcmvk/Kconfig"
osource "/home/starlark/github/zephyr/soc/brcm/bcm2712/Kconfig"
osource "/home/starlark/github/zephyr/soc/brcm/bcm2711/Kconfig"
osource "/home/starlark/github/zephyr/soc/atmel/sam0/Kconfig"
osource "/home/starlark/github/zephyr/soc/atmel/sam/Kconfig"
osource "/home/starlark/github/zephyr/soc/aspeed/Kconfig"
osource "/home/starlark/github/zephyr/soc/arm/Kconfig"
osource "/home/starlark/github/zephyr/soc/arm/beetle/Kconfig"
osource "/home/starlark/github/zephyr/soc/andestech/Kconfig"
osource "/home/starlark/github/zephyr/soc/ambiq/Kconfig"
osource "/home/starlark/github/zephyr/soc/altr/zephyr_nios2f/Kconfig"
osource "/home/starlark/github/zephyr/soc/altr/qemu_nios2/Kconfig"
osource "/home/starlark/github/zephyr/soc/adi/max32/Kconfig"
```

## build-wl/Kconfig/soc/Kconfig.defconfig
```kconfig
# Load Zephyr SoC Kconfig defconfig.
osource "/home/starlark/github/zephyr/soc/xlnx/zynqmp/Kconfig.defconfig"
osource "/home/starlark/github/zephyr/soc/xlnx/zynq7000/Kconfig.defconfig"
osource "/home/starlark/github/zephyr/soc/xen/Kconfig.defconfig"
osource "/home/starlark/github/zephyr/soc/ti/simplelink/Kconfig.defconfig"
osource "/home/starlark/github/zephyr/soc/ti/lm3s6965/Kconfig.defconfig"
osource "/home/starlark/github/zephyr/soc/ti/k3/Kconfig.defconfig"
osource "/home/starlark/github/zephyr/soc/telink/tlsr/Kconfig.defconfig"
osource "/home/starlark/github/zephyr/soc/starfive/jh71xx/Kconfig.defconfig"
osource "/home/starlark/github/zephyr/soc/st/stm32/Kconfig.defconfig"
osource "/home/starlark/github/zephyr/soc/snps/qemu_arc/Kconfig.defconfig"
osource "/home/starlark/github/zephyr/soc/snps/nsim/arc_v/Kconfig.defconfig"
osource "/home/starlark/github/zephyr/soc/snps/nsim/arc_classic/Kconfig.defconfig"
osource "/home/starlark/github/zephyr/soc/snps/hsdk4xd/Kconfig.defconfig"
osource "/home/starlark/github/zephyr/soc/snps/hsdk/Kconfig.defconfig"
osource "/home/starlark/github/zephyr/soc/snps/emsk/Kconfig.defconfig"
osource "/home/starlark/github/zephyr/soc/snps/emsdp/Kconfig.defconfig"
osource "/home/starlark/github/zephyr/soc/snps/arc_iot/Kconfig.defconfig"
osource "/home/starlark/github/zephyr/soc/silabs/Kconfig.defconfig"
osource "/home/starlark/github/zephyr/soc/sifive/sifive_freedom/Kconfig.defconfig"
osource "/home/starlark/github/zephyr/soc/rockchip/Kconfig.defconfig"
osource "/home/starlark/github/zephyr/soc/renode/riscv_virtual/Kconfig.defconfig"
osource "/home/starlark/github/zephyr/soc/renesas/smartbond/Kconfig.defconfig"
osource "/home/starlark/github/zephyr/soc/renesas/rzt2m/Kconfig.defconfig"
osource "/home/starlark/github/zephyr/soc/renesas/rcar/Kconfig.defconfig"
osource "/home/starlark/github/zephyr/soc/renesas/ra/Kconfig.defconfig"
osource "/home/starlark/github/zephyr/soc/raspberrypi/Kconfig.defconfig"
osource "/home/starlark/github/zephyr/soc/quicklogic/eos_s3/Kconfig.defconfig"
osource "/home/starlark/github/zephyr/soc/qemu/virt_riscv/Kconfig.defconfig"
osource "/home/starlark/github/zephyr/soc/qemu/malta/Kconfig.defconfig"
osource "/home/starlark/github/zephyr/soc/openisa/rv32m1/Kconfig.defconfig"
osource "/home/starlark/github/zephyr/soc/nxp/s32/Kconfig.defconfig"
osource "/home/starlark/github/zephyr/soc/nxp/rw/Kconfig.defconfig"
osource "/home/starlark/github/zephyr/soc/nxp/mcx/Kconfig.defconfig"
osource "/home/starlark/github/zephyr/soc/nxp/lpc/Kconfig.defconfig"
osource "/home/starlark/github/zephyr/soc/nxp/layerscape/Kconfig.defconfig"
osource "/home/starlark/github/zephyr/soc/nxp/kinetis/Kconfig.defconfig"
osource "/home/starlark/github/zephyr/soc/nxp/imxrt/Kconfig.defconfig"
osource "/home/starlark/github/zephyr/soc/nxp/imx/Kconfig.defconfig"
osource "/home/starlark/github/zephyr/soc/nuvoton/numicro/Kconfig.defconfig"
osource "/home/starlark/github/zephyr/soc/nuvoton/numaker/Kconfig.defconfig"
osource "/home/starlark/github/zephyr/soc/nuvoton/npcx/Kconfig.defconfig"
osource "/home/starlark/github/zephyr/soc/nordic/Kconfig.defconfig"
osource "/home/starlark/github/zephyr/soc/neorv32/Kconfig.defconfig"
osource "/home/starlark/github/zephyr/soc/native/inf_clock/Kconfig.defconfig"
osource "/home/starlark/github/zephyr/soc/microchip/miv/Kconfig.defconfig"
osource "/home/starlark/github/zephyr/soc/microchip/mec/Kconfig.defconfig"
osource "/home/starlark/github/zephyr/soc/mediatek/mtk_adsp/Kconfig.defconfig"
osource "/home/starlark/github/zephyr/soc/lowrisc/opentitan/Kconfig.defconfig"
osource "/home/starlark/github/zephyr/soc/litex/litex_vexriscv/Kconfig.defconfig"
osource "/home/starlark/github/zephyr/soc/ite/ec/Kconfig.defconfig"
osource "/home/starlark/github/zephyr/soc/intel/raptor_lake/Kconfig.defconfig"
osource "/home/starlark/github/zephyr/soc/intel/lakemont/Kconfig.defconfig"
osource "/home/starlark/github/zephyr/soc/intel/intel_socfpga_std/Kconfig.defconfig"
osource "/home/starlark/github/zephyr/soc/intel/intel_socfpga/Kconfig.defconfig"
osource "/home/starlark/github/zephyr/soc/intel/intel_niosv/Kconfig.defconfig"
osource "/home/starlark/github/zephyr/soc/intel/intel_ish/Kconfig.defconfig"
osource "/home/starlark/github/zephyr/soc/intel/intel_adsp/Kconfig.defconfig"
osource "/home/starlark/github/zephyr/soc/intel/elkhart_lake/Kconfig.defconfig"
osource "/home/starlark/github/zephyr/soc/intel/atom/Kconfig.defconfig"
osource "/home/starlark/github/zephyr/soc/intel/apollo_lake/Kconfig.defconfig"
osource "/home/starlark/github/zephyr/soc/intel/alder_lake/Kconfig.defconfig"
osource "/home/starlark/github/zephyr/soc/infineon/cat3/Kconfig.defconfig"
osource "/home/starlark/github/zephyr/soc/infineon/cat1b/Kconfig.defconfig"
osource "/home/starlark/github/zephyr/soc/infineon/cat1a/Kconfig.defconfig"
osource "/home/starlark/github/zephyr/soc/gd/gd32/Kconfig.defconfig"
osource "/home/starlark/github/zephyr/soc/gaisler/leon3/Kconfig.defconfig"
osource "/home/starlark/github/zephyr/soc/gaisler/gr716a/Kconfig.defconfig"
osource "/home/starlark/github/zephyr/soc/espressif/Kconfig.defconfig"
osource "/home/starlark/github/zephyr/soc/ene/kb1200/Kconfig.defconfig"
osource "/home/starlark/github/zephyr/soc/efinix/sapphire/Kconfig.defconfig"
osource "/home/starlark/github/zephyr/soc/cdns/xtensa_sample_controller/Kconfig.defconfig"
osource "/home/starlark/github/zephyr/soc/cdns/dc233c/Kconfig.defconfig"
osource "/home/starlark/github/zephyr/soc/brcm/bcmvk/Kconfig.defconfig"
osource "/home/starlark/github/zephyr/soc/brcm/bcm2712/Kconfig.defconfig"
osource "/home/starlark/github/zephyr/soc/brcm/bcm2711/Kconfig.defconfig"
osource "/home/starlark/github/zephyr/soc/atmel/sam0/Kconfig.defconfig"
osource "/home/starlark/github/zephyr/soc/atmel/sam/Kconfig.defconfig"
osource "/home/starlark/github/zephyr/soc/aspeed/Kconfig.defconfig"
osource "/home/starlark/github/zephyr/soc/arm/Kconfig.defconfig"
osource "/home/starlark/github/zephyr/soc/arm/beetle/Kconfig.defconfig"
osource "/home/starlark/github/zephyr/soc/andestech/Kconfig.defconfig"
osource "/home/starlark/github/zephyr/soc/ambiq/Kconfig.defconfig"
osource "/home/starlark/github/zephyr/soc/altr/zephyr_nios2f/Kconfig.defconfig"
osource "/home/starlark/github/zephyr/soc/altr/qemu_nios2/Kconfig.defconfig"
osource "/home/starlark/github/zephyr/soc/adi/max32/Kconfig.defconfig"
```
